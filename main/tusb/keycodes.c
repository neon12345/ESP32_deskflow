#include "keycodes.h"
#include "esp_log.h"

/* Deskflow key protocol constants (from KeyTypes.h) */
/* KeyID encoding is UTF-32 for printable chars, X11 keysym-0x1000 for specials */
#define BARRIER_KEY_LEFT_TAB   0xEE20
#define BARRIER_EXT_BASE       0xEF00

/* Deskflow mask bits - logical modifiers */
#define DF_MASK_SHIFT          0x0001
#define DF_MASK_CONTROL        0x0002
#define DF_MASK_ALT            0x0004
#define DF_MASK_META           0x0008
#define DF_MASK_SUPER          0x0010
#define DF_MASK_ALTGR          0x0020
#define DF_MASK_LEVEL5LOCK     0x0040
#define DF_MASK_CAPSLOCK       0x1000

#define HID_MOD_LEFT_CTRL      0x01
#define HID_MOD_LEFT_SHIFT     0x02
#define HID_MOD_LEFT_ALT       0x04
#define HID_MOD_LEFT_GUI       0x08
#define HID_MOD_RIGHT_CTRL     0x10
#define HID_MOD_RIGHT_SHIFT    0x20
#define HID_MOD_RIGHT_ALT      0x40
#define HID_MOD_RIGHT_GUI      0x80

// Lookup table: UTF-32 char -> HID usage code (US QWERTY)
// Verified against standard US HID keyboard usage positions - no changes needed.
static const uint8_t TABLE_US[256] = {
    0x00, 0x00, 0x00, 0x00, 0x00, 0x00, 0x00, 0x00, 0x00, 0x00, 0x00, 0x00, 0x00, 0x00, 0x00, 0x00,
    0x00, 0x00, 0x00, 0x00, 0x00, 0x00, 0x00, 0x00, 0x00, 0x00, 0x00, 0x00, 0x00, 0x00, 0x00, 0x00,
    0x2C, 0x1E, 0x34, 0x20, 0x21, 0x22, 0x24, 0x34, 0x26, 0x27, 0x25, 0x2E, 0x36, 0x2D, 0x37, 0x38,
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    0x00, 0x00, 0x00, 0x00, 0x00, 0x00, 0x00, 0x00, 0x00, 0x00, 0x00, 0x00, 0x00, 0x00, 0x00, 0x00
};

// Lookup table: UTF-32 char -> HID usage code (German QWERTZ)
// Deskflow sends Unicode char values. Map to the HID key that produces that char on DE layout.
// Modifiers (Shift, AltGr) are sent separately via the mask -- EXCEPT this table has no way to
// signal "this char needs AltGr" back to the caller (barrier_key_to_hid only returns one usage
// byte). Characters that only exist behind AltGr on German layout (@ [ ] { } | ~ \) are therefore
// left unmapped (0x00) rather than pointing at a plain key that produces the wrong character.
// If those are needed, extend the return type to also carry a required-modifier byte.
static const uint8_t TABLE_DE[256] = {
    // 0x00-0x1F: control chars
    0x00, 0x00, 0x00, 0x00, 0x00, 0x00, 0x00, 0x00, 0x00, 0x00, 0x00, 0x00, 0x00, 0x00, 0x00, 0x00,
    0x00, 0x00, 0x00, 0x00, 0x00, 0x00, 0x00, 0x00, 0x00, 0x00, 0x00, 0x00, 0x00, 0x00, 0x00, 0x00,
    // 0x20-0x2F: ' ' through '/'
    //  '  '   !   "   #   $   %   &   '   (   )   *   +   ,   -   .   /
    // '#' -> Non-US "#~" key (0x32), not shift+3 (which is section-sign section-sign on DE)
    // '\'' -> no clean single key on DE (needs the acute dead-key), left unmapped
    // '*' -> the +/* key (0x30), NOT the same key as '('
    // '+' -> the +/* key (0x30), NOT the same key as '='
    // '-' -> the -/_ key (0x38), NOT the ß key
    0x2C, 0x1E, 0x1F, 0x32, 0x21, 0x22, 0x23, 0x31, 0x25, 0x26, 0x30, 0x30, 0x36, 0x38, 0x37, 0x24,
    // 0x30-0x3F: '0' through '?'
    //  0   1   2   3   4   5   6   7   8   9   :   ;   <   =   >   ?
    // ':' -> shift+'.' key (0x37), NOT the same key as ';'
    // ';' -> shift+',' key (0x36), NOT the same key as ':'
    // '<'/'>' -> the ISO Non-US \|  key (0x64), NOT the Ä key
    // '?' -> shift+ß key (0x2D), NOT the same key as '0'/'='
    0x27, 0x1E, 0x1F, 0x20, 0x21, 0x22, 0x23, 0x24, 0x25, 0x26, 0x37, 0x36, 0x64, 0x27, 0x64, 0x2D,
    // 0x40-0x4F: '@' through 'O'
    // '@' is AltGr+Q on DE. AltGr is supplied by mask_to_tusb_modifier from Deskflow's
    // mask (DF_MASK_ALTGR -> HID_MOD_RIGHT_ALT), so this table just returns the Q key.
    0x14, 0x04, 0x05, 0x06, 0x07, 0x08, 0x09, 0x0A, 0x0B, 0x0C, 0x0D, 0x0E, 0x0F, 0x10, 0x11, 0x12,
    // 0x50-0x5F: 'P' through '_'
    //  P   Q   R   S   T   U   V   W   X   Y   Z   [   \   ]   ^   _
    // Y/Z swapped vs US (correct - matches physical DE key legends)
    // '[' = AltGr+8 (0x25), '\' = AltGr+ß (0x2D), ']' = AltGr+9 (0x26)
    // '_' -> shift+'-' key (0x38), NOT the ß key
    0x13, 0x14, 0x15, 0x16, 0x17, 0x18, 0x19, 0x1A, 0x1B, 0x1D, 0x1C, 0x25, 0x2D, 0x26, 0x33, 0x38,
    // 0x60-0x6F: '`' through 'o'
    // '`' is a dead-key sequence on DE (no AltGr binding, needs two keypresses) -- left unmapped
    0x00, 0x04, 0x05, 0x06, 0x07, 0x08, 0x09, 0x0A, 0x0B, 0x0C, 0x0D, 0x0E, 0x0F, 0x10, 0x11, 0x12,
    // 0x70-0x7F: 'p' through DEL
    //  p   q   r   s   t   u   v   w   x   y   z   {   |   }   ~  DEL
    // '{' = AltGr+7 (0x24), '|' = AltGr+< ISO key (0x64), '}' = AltGr+0 (0x27), '~' = AltGr++ (0x30)
    // DEL is a control code, not a printable key -- must not map to '1' (was a bug)
    0x13, 0x14, 0x15, 0x16, 0x17, 0x18, 0x19, 0x1A, 0x1B, 0x1D, 0x1C, 0x24, 0x64, 0x27, 0x30, 0x00,
    // 0x80-0x9F: C1 controls, unused
    0x00, 0x00, 0x00, 0x00, 0x00, 0x00, 0x00, 0x00, 0x00, 0x00, 0x00, 0x00, 0x00, 0x00, 0x00, 0x00,
    0x00, 0x00, 0x00, 0x00, 0x00, 0x00, 0x00, 0x00, 0x00, 0x00, 0x00, 0x00, 0x00, 0x00, 0x00, 0x00,
    // 0xA0-0xAF: NBSP through, includes '§' (U+00A7) at index 7 -- shift+3 on DE
    0x00, 0x00, 0x00, 0x00, 0x00, 0x00, 0x00, 0x20, 0x00, 0x00, 0x00, 0x00, 0x00, 0x00, 0x00, 0x00,
    // 0xB0-0xBF: no direct single-key DE equivalents
    0x35, 0x00, 0x00, 0x00, 0x00, 0x00, 0x00, 0x00, 0x00, 0x00, 0x00, 0x00, 0x00, 0x00, 0x00, 0x00,
    // 0xC0-0xCF: includes 'Ä' (U+00C4) at index 4 -- the Ä key
    0x00, 0x00, 0x00, 0x00, 0x34, 0x00, 0x00, 0x00, 0x00, 0x00, 0x00, 0x00, 0x00, 0x00, 0x00, 0x00,
    // 0xD0-0xDF: includes 'Ö' (0xD6, idx6) -> Ö key, 'Ü' (0xDC, idx12) -> Ü key, 'ß' (0xDF, idx15) -> ß key
    0x00, 0x00, 0x00, 0x00, 0x00, 0x00, 0x33, 0x00, 0x00, 0x00, 0x00, 0x00, 0x2F, 0x00, 0x00, 0x2D,
    // 0xE0-0xEF: includes 'ä' (U+00E4) at index 4 -- the Ä key
    0x00, 0x00, 0x00, 0x00, 0x34, 0x00, 0x00, 0x00, 0x00, 0x00, 0x00, 0x00, 0x00, 0x00, 0x00, 0x00,
    // 0xF0-0xFF: includes 'ö' (0xF6, idx6) -> Ö key, 'ü' (0xFC, idx12) -> Ü key
    0x00, 0x00, 0x00, 0x00, 0x00, 0x00, 0x33, 0x00, 0x00, 0x00, 0x00, 0x00, 0x2F, 0x00, 0x00, 0x00
};

// Extended table: barrier key 0xEF00+ -> HID usage (same for US/DE)
// Verified against X11 keysym layout (0xFF00 + index) - modifiers, arrows, F-keys all check out.
static const uint8_t EXT_TAB[256] = {
    0x00, 0x00, 0x00, 0x00, 0x00, 0x00, 0x00, 0x00, 0x2A, 0x2B, 0x00, 0x9C, 0x00, 0x28, 0x00, 0x00,
    0x00, 0x00, 0x00, 0x48, 0x47, 0x9A, 0x00, 0x00, 0x00, 0x00, 0x00, 0x29, 0x00, 0x00, 0x00, 0x00,
    0x00, 0x00, 0x00, 0x00, 0x00, 0x00, 0x00, 0x00, 0x00, 0x00, 0x00, 0x00, 0x00, 0x00, 0x00, 0x00,
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    0x00, 0x00, 0x00, 0x00, 0x00, 0x00, 0x00, 0x00, 0x00, 0x00, 0x00, 0x00, 0x00, 0x00, 0x00, 0x4C
};

// Sparse lookup for Unicode characters above 0xFF
static const struct { uint16_t ch; uint8_t hid; } HIGH_CHARS[] = {
    { 0x20AC, 0x08 },  // € -> e (HID_KEY_E)
    { 0x0302, 0x35 },
    { 0x0301, 0x2E },
    { 0x0300, 0x2E },
};
#define HIGH_CHARS_COUNT (sizeof(HIGH_CHARS) / sizeof(HIGH_CHARS[0]))

static const uint8_t *s_table   = TABLE_US;

void keycodes_set_layout(uint8_t layout)
{
    if (layout >= KEYBOARD_LAYOUT_COUNT) return;
    switch (layout) {
        case KEYBOARD_LAYOUT_US:
            s_table   = TABLE_US;
            break;
        case KEYBOARD_LAYOUT_DE:
            s_table   = TABLE_DE;
            break;
    }
}

uint8_t barrier_key_to_hid(uint16_t barrier_key)
{
    uint8_t hid;
    if (barrier_key == BARRIER_KEY_LEFT_TAB) {
        return HID_KEY_TAB;
    } else if (barrier_key < 0x100) {
        hid = s_table[barrier_key];
    } else if (barrier_key >= BARRIER_EXT_BASE && barrier_key <= BARRIER_EXT_BASE + 255) {
        hid = EXT_TAB[barrier_key - BARRIER_EXT_BASE];
    } else {
        // Check high-range Unicode characters
        hid = HID_KEY_NONE;
        for (uint8_t i = 0; i < HIGH_CHARS_COUNT; i++) {
            if (HIGH_CHARS[i].ch == barrier_key) {
                hid = HIGH_CHARS[i].hid;
                break;
            }
        }
    }
    // here adds needless per-keystroke overhead on a KVM/keyboard-forwarding path.
    ESP_LOGD("keycodes", "key 0x%04x -> HID 0x%02x [%s]", barrier_key, hid, hid == 0 ? "UNMAPPED" : "OK");
    return hid;
}

uint8_t mask_to_tusb_modifier(uint16_t df_mask)
{
    uint8_t modifier = 0;

    // Deskflow uses LOGICAL modifiers, not left/right. Map to left-side HID keys.
    // AltGr -> Right Ctrl (physically Right Ctrl on ALL PC keyboards,
    // the OS interprets Right Ctrl as AltGr for layout purposes)
    // Meta -> Right Alt (X11 convention)
    if (df_mask & DF_MASK_SHIFT)      modifier |= HID_MOD_LEFT_SHIFT;
    if (df_mask & DF_MASK_CONTROL)    modifier |= HID_MOD_LEFT_CTRL;
    if (df_mask & DF_MASK_ALT)        modifier |= HID_MOD_LEFT_ALT;
    if (df_mask & DF_MASK_META)       modifier |= HID_MOD_RIGHT_ALT;
    if (df_mask & DF_MASK_SUPER)      modifier |= HID_MOD_LEFT_GUI;
    if (df_mask & DF_MASK_ALTGR)      modifier |= HID_MOD_RIGHT_ALT;
    // Level5Lock and CapsLock have no HID modifier bit

    ESP_LOGD("keycodes", "mask 0x%04x -> HID mod 0x%02x", df_mask, modifier);
    return modifier;
}
